## conf/layer.conf
```bitbake
# We have a conf and classes directory, add to BBPATH
BBPATH .= ":${LAYERDIR}"

# We have recipes-* directories, add to BBFILES
BBFILES += "${LAYERDIR}/recipes-*/*/*.bb \
            ${LAYERDIR}/recipes-*/*/*.bbappend"

BBFILE_COLLECTIONS += "patito"
BBFILE_PATTERN_patito = "^${LAYERDIR}/"
BBFILE_PRIORITY_patito = "5"
LAYERVERSION_patito = "1"
LAYERSERIES_COMPAT_patito = "dunfell"
```
